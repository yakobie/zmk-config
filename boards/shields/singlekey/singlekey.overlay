/ {
    chosen {
        zmk,kscan = &default_kscan;
    };

    default_kscan: kscan {
        compatible = "zmk,kscan-gpio-direct";

        input-gpios =
            <&gpio0 6 (GPIO_ACTIVE_LOW | GPIO_PULL_UP)>;
    };

};