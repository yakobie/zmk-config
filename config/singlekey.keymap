#include <behaviors.dtsi>
#include <dt-bindings/zmk/keys.h>
#include <dt-bindings/zmk/bt.h>
#include <dt-bindings/zmk/mouse.h>

/ {
    keymap {
        compatible = "zmk,keymap";
        
        default_layer {
            bindings = <
                &mkp LCLK    // First button: Mouse left click
                &bt BT_CLR   // Second button: Bluetooth clear
            >;
        };

        bt_layer {
            bindings = <
                &bt BT_CLR
            >;
        };
    };
};